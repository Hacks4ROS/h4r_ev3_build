## build/conf/bblayers.conf
```bitbake
# LAYER_CONF_VERSION is increased each time build/conf/bblayers.conf
# changes incompatibly
LCONF_VERSION = "6"

BBPATH = "${TOPDIR}"
DISTPATH =  "${TOPDIR}/../dist/poky"
EXTRA_LAYER_PATH =  "${TOPDIR}/../extra-layers"
BBFILES ?= "" 

BBLAYERS ?= " \
  ${DISTPATH}/meta \
  ${DISTPATH}/meta-yocto \
  ${DISTPATH}/meta-yocto-bsp \
  ${EXTRA_LAYER_PATH}/meta-openembedded/meta-oe \
  ${EXTRA_LAYER_PATH}/meta-openembedded/meta-python \
  ${EXTRA_LAYER_PATH}/meta-openembedded/meta-multimedia \
  ${EXTRA_LAYER_PATH}/meta-openembedded/meta-efl \
  ${EXTRA_LAYER_PATH}/meta-openembedded/meta-gnome \
  ${EXTRA_LAYER_PATH}/meta-openembedded/meta-gpe \
  ${EXTRA_LAYER_PATH}/meta-openembedded/meta-initramfs \
  ${EXTRA_LAYER_PATH}/meta-openembedded/meta-perl \
  ${EXTRA_LAYER_PATH}/meta-openembedded/meta-python \ 
  ${EXTRA_LAYER_PATH}/meta-openembedded/meta-ruby \
  ${EXTRA_LAYER_PATH}/meta-openembedded/meta-systemd \
  ${EXTRA_LAYER_PATH}/meta-openembedded/meta-webserver \
  ${EXTRA_LAYER_PATH}/meta-openembedded/meta-xfce \ 
  ${EXTRA_LAYER_PATH}/meta-openembedded/meta-networking \
  ${EXTRA_LAYER_PATH}/meta-openembedded/meta-filesystems \
  ${EXTRA_LAYER_PATH}/meta-ti \
  ${EXTRA_LAYER_PATH}/meta-ros \
  ${EXTRA_LAYER_PATH}/meta-h4r-ev3/meta-h4r-ev3dev \
  ${EXTRA_LAYER_PATH}/meta-h4r-ev3/meta-h4r-ev3dev-services \
  "  
BBLAYERS_NON_REMOVABLE ?= " \
  ${DISTPATH}/meta \
  ${DISTPATH}/meta-yocto \
  "
```

## build/conf/local.conf
```bitbake
DISTRO ?= "poky"
DISTRO_FEATURES_append = " systemd pam" 
VIRTUAL-RUNTIME_init_manager = "systemd"

DISTRO_FEATURES_BACKFILL_CONSIDERED = "sysvinit" 
VIRTUAL-RUNTIME_initscripts = ""
SYSVINIT_ENABLED_GETTYS = ""

USER_CLASSES ?= "buildstats image-mklibs image-prelink"

PATCHRESOLVE = "noop"

BB_DISKMON_DIRS = "\
    STOPTASKS,${TMPDIR},1G,100K \
    STOPTASKS,${DL_DIR},1G,100K \
    STOPTASKS,${SSTATE_DIR},1G,100K \
    ABORT,${TMPDIR},100M,1K \
    ABORT,${DL_DIR},100M,1K \
    ABORT,${SSTATE_DIR},100M,1K" 

CONF_VERSION = "1"

SUMMARY = "H4R_EV3"
BB_NUMBER_THREADS ?= "6"
PARALLEL_MAKE ?= "-j 6"
IMAGE_FEATURES += "package-management"
PACKAGE_CLASSES ?= "package_deb"
MACHINE = "ev3dev"
EXTRA_IMAGE_FEATURES += "debug-tweaks eclipse-debug tools-sdk tools-debug dev-pkgs"
IMAGE_INSTALL += " meta-ide-support meta-toolchain"
IMAGE_FEATURES += " ssh-server-openssh"
PREFERRED_PROVIDER_jpeg = "jpeg"
PREFERRED_PROVIDER_jpeg-native = "jpeg-native"
PREFERRED_PROVIDER_u-boot ="u-boot"
LICENSE_FLAGS_WHITELIST = "commercial" 
GCCVERSION = "4.9%"
# build some core libs with heavier compiler optimization
#O3_OPT = "-O3 -pipe ${DEBUG_FLAGS}"
#FULL_OPTIMIZATION_pn-libgcrypt = "${O3_OPT}"
#FULL_OPTIMIZATION_pn-zlib = "${O3_OPT}"
```
